//201804594 손무현 의용전자및실습 기말프로젝트

#include <Wire.h>  
#include <LiquidCrystal_I2C.h> //LCD 모듈
#include <DHT.h> //(온습도센서모듈)
#include <SoftwareSerial.h> // 소프트웨어 시리얼 라이브러리 불러옴 (블루투스 모듈)
#include <talkie.h> // 스피커&앰프 모듈
#define DHTPIN 7     // 디지털 7번핀 사용 (온습도 센서 모듈)
#define DHTTYPE DHT11   // DHT 11 모델사용 (DHT21/22 사용 가능) (온 습도 센서 모듈)
int Huimidifier = 13; //가습기 모듈은 13번핀을 사용(실제로는 릴레이 모듈을 연결하고 그 릴레이 모듈을 13번핀으로 제어함으로써 릴레이 모듈에 연결되어 있는 가습기 모듈을 제어)
int BT_RXD = 9; // 아두이노측 수신부 RXD는 9번핀(HC-09측 송신부 TXD와 연결) (블루투스 모듈)
int BT_TXD = 10; // 아두이노측 송신부 TXD는 10번핀(HC-10측 수신부 RXD와 연결) (블루투스 모듈)
Talkie voice; //(스피커 모듈)
SoftwareSerial bluetooth(10,9);   // 소프트웨어 시리얼 bluetooth 객체 선언

//습도가 40%밑으로 내려갔습니다. 가습기를 가동합니다. (스피커 모듈)
const uint8_t spdhumid[] PROGMEM = {0x80, 0xc8, 0xc8, 0x3d, 0xd2, 0xdc, 0xb6, 0xa2, 0x9a, 0x12, 0x8b, 0x30, 0x3b,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 0x80, 0xff};
//습도가 60%이상으로 올라갔습니다. 가습기를 가동을 멈춥니다. (스피커 모듈)
const uint8_t spahumid[] PROGMEM = {0x40, 0xbc, 0x4c, 0xd5, 0xd3, 0xd5, 0x4a, 0xf0, 0xba, 0xe4, 0x2c, 0x77, 0xcb,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 0x78, 0xff};

 
LiquidCrystal_I2C lcd(0x27,16,2); //LCD 설정 (I2C주소는 LCD의 종류에 따라 다르기때문에 LCD가 0x3F, 0x20, 0x27인지 확인하세요)
DHT dht(DHTPIN, DHTTYPE); //DHT 설정
 
void setup()          // 한 번만 수행할 것들
{
  lcd.init(); //LCD 화면을 초기화
  Serial.begin(9600);  //9600속도로 시리얼 통신 시작
  bluetooth.begin(9600);  // 블루투스 통신 시작
  dht.begin(); //
  pinMode(13,OUTPUT); //가습기 동작은 디지털핀 13번핀 사용(13번핀을 출력으로 사용)
  pinMode(12,OUTPUT);
  lcd.backlight(); // LCD의 백라이트 점등시킨다.
  lcd.clear(); //LCD 화면의 모든 내용을 지움
  
}
 
void loop() {                 //반복해서 수행할 것들
  // 온 습도 모듈과 LCD 화면 출력*************************************************************************************
  float h = dht.readHumidity(); // 변수 h에 습도 값을 저장
  float t = dht.readTemperature(); // 변수 t에 온도 값을 저장
   
  lcd.backlight(); //LCD의 백라이트 점등
  lcd.display();
  lcd.print("TEMP:     "); //LCD 화면에 문자열 :"TEMP:     "를 출력
  lcd.print(t);   //LCD 화면에 온도값 출력
  lcd.setCursor(0,1); // LCD 화면에 문자열을 출력할 위치를 설정 (즉, 커서를 두번 쨰 줄 첫번 째 칸으로 설정)
  lcd.print("HUMIDITY: "); // LCD 화면에 "HUMIDITY:   " 출력
  lcd.print(h); //LCD 화면에 습도 값 출력
 
 /* Serial.print("습도: ");  (시리얼 모니터를 통해 온습도에 대한 정보를 모니터링 하고자 하면 해당 주석처리를 지우면 됨)
  Serial.print(h);
  Serial.print(" 온도: ");
  Serial.print(t);
  Serial.println();  */
  delay(2000); //2초 간격으로 업데이트
  lcd.clear(); //LCD 화면의 모든 내용을 지움
 //****************************************************************************************************

 // 가습기 모듈(릴레이모듈)과 음성출력************************************************************************
  if(h>60){                 //습도가 60%위로 올라갔을떄 
     digitalWrite(13,HIGH); //가습기 가동
     voice.say(spahumid);   //습도가 60%위로 올라갔다는 알림음 출력
     }
  else if(h==61){           //습도가 60%위로 올라갔을떄 
       
     voice.say(spahumid);   //습도가 60%위로 올라갔다는 알림음 출력
     }
  else if(h==39){           //습도가 40%밑으로 내려갔을떄
       
       voice.say(spdhumid); //습도가 40%밑으로 내려갔다는 알림음 출력
     }
  else{
      digitalWrite(13,LOW); //가습기 가동
  }

 /* 시연 영상에서는 임시로 영상촬영을 위해 위에 있는 코드를 사용하였습니다.
  -실제로 구현하려한 것에 대한 코드
  
  if(h==61){                //습도가 60%위로 올라갔을떄 
     
     voice.say(spahumid);/ / 습도가 60%위로 올라갔다는 알림음 출력
     }

  else if(h>60){  
     
     digitalWrite(13,LOW); //가습기 중단
     }
  
  else if(h==39){    //습도가 40%밑으로 내려갔을떄
       
       voice.say(spdhumid);//습도가 40%밑으로 내려갔다는 알림음 출력
     }
 
  else{
      digitalWrite(13,HIGH); //가습기 가동
  }
  */ 
//******************************************************************************************************


// 블루투스 모듈******************************************************************************************
    if (bluetooth.available()) {      // 블루투스 통신에 데이터가 입력되면(스마트폰 -> 아두이노)
    Serial.write(bluetooth.read()); // 블루투스 통신에 입력된 데이터를 시리얼 모니터로 출력(스마트폰 -> 아두이노 -> PC)

    
    char bt = bluetooth.read();
    Serial.write(bt); // 블루투스 통신에 입력된 데이터를 시리얼 모니터로 출력(스마트폰 -> 아두이노 -> PC)
 /* 작동시키고자 하는 방향대로 코드를 짜보았지만 정상적으로 작동하지 않아(문자열을 아두이노 측에서 정상적으로 인식하지 못해서) 계속해서 임의로 수정하고 한 번 누를 때마다 ON/OFF 모드가 바뀌는 스위치에 대한 코드를 참고하여 작성했습니다. 
 결과적으로 목표한 작동/멈춤에 대한 제어가 정상적으로 이루어 지도록 하는 것에 성공했습니다.어차피 a를 입력해도 a라고 인식하지 못하기 때문에 그 점을 반대로 이용하여 입력값이 'a'가 아니라면 작동(혹은 멈춤)시키도록 했습니다.
 따라서 a가 아닌 어떠한 임의의 문자열을 입력하더라도 동작과 멈춤이 정상적으로 실행됩니다.*/
    if(bt != 'a'){     //스마트폰으로 입력한 문자열이 'a'가 아니라면
     while(bt != 'a'){
     digitalWrite(13,HIGH); //가습기 작동
  
     if (bluetooth.available()) {    //블루투스 통신에 데이터가 입력되면
      Serial.write(bluetooth.read()); //블루투스 통신에 입력된 데이터를 시리얼 모니터로 출력(스마트폰 -> 아두이노 -> PC)
      bt = bluetooth.read(); //블루투스 통신에 입력된 데이터를 bt라는 변수에 저장
      if(bt != 'a'){break;}  //입력된 데이터가 'a'가 아니라면
      }
     }
     }
    else if(bt != 'a'){      //스마트폰으로 입력한 값이 'a'가 아니라면
     digitalWrite(13,LOW);   //가습기 멈춤
     
     delay(7000);            //7초 동안 딜레이

//*****************************************************************************************************
     }
    }
  }
  }
